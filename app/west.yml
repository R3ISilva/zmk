## app/west.yml
```yaml
manifest:
  remotes:
    - name: zephyrproject-rtos
      url-base: https://github.com/zephyrproject-rtos
    - name: zmkfirmware
      url-base: https://github.com/zmkfirmware
    - name: R3ISilva # Add your GitHub username as a remote
      url-base: https://github.com/R3ISilva
  projects:
    - name: zephyr
      remote: zmkfirmware
      revision: v3.5.0+zmk-fixes
      clone-depth: 1
      import:
        name-blocklist:
          - ci-tools
          - hal_altera
          - hal_cypress
          - hal_infineon
          - hal_microchip
          - hal_nxp
          - hal_openisa
          - hal_silabs
          - hal_xtensa
          - hal_st
          - hal_ti
          - loramac-node
          - mcuboot
          - mcumgr
          - net-tools
          - openthread
          - edtt
          - trusted-firmware-m
    - name: nanopb
      revision: 8c60555d6277a0360c876bd85d491fc4fb0cd74a
      path: modules/lib/nanopb
      remote: zmkfirmware
    - name: zmk-studio-messages
      revision: 6cb4c283e76209d59c45fbcb218800cd19e9339d
      path: modules/msgs/zmk-studio-messages
      remote: zmkfirmware
    - name: shield-module-36key # My custom shield module
      path: boards/shields/36keyendgame # Destination folder in the ZMK repo
      revision: main  # Change this to the correct branch name
      remote: R3ISilva
  self:
    west-commands: scripts/west-commands.yml
```
